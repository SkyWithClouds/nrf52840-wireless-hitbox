## boards/nologo/nologo_promicro/Kconfig.nologo_promicro
```kconfig
# SPDX-License-Identifier: MIT
config BOARD_NOLOGO_PROMICRO
	select SOC_NRF52840_QIAA
```

## boards/nologo/nologo_promicro/board.yml
```yaml
board:
  name: nologo_promicro
  full_name: NOLOGO ProMicro nRF52840
  vendor: others
  socs:
    - name: nrf52840
```

## boards/nologo/nologo_promicro/nologo_promicro_defconfig
```kconfig
CONFIG_ARM_MPU=y
CONFIG_USE_DT_CODE_PARTITION=y
CONFIG_BUILD_OUTPUT_UF2=y
CONFIG_BUILD_OUTPUT_UF2_FAMILY_ID="0xADA52840"
```

## west.yml
```yaml
manifest:
  remotes:
    - name: nordic
      url-base: https://github.com/nrfconnect
  projects:
    - name: nrf
      remote: nordic
      repo-path: sdk-nrf
      revision: 4ab7b98fc76f658249bd8553cf8f9253ff840a53  # v2.9.2
      import:
        name-allowlist:
          - zephyr
          - hal_nordic
          - cmsis
          - nrfxlib
          - segger
  self:
    path: bridge
```
